/***********************************************************************************************
			文件名：buffer.c
			功能：数据缓存区相关函数
			编写人：程吉利
			时间：2014年5月
***********************************************************************************************/
#include "stm32f10x.h"
#include "buffer.h"

uint8_t is_full(Buffer *buff);
uint16_t get_size(Buffer *buff);
/******************************************************************************
	函数名：void buffer_init(Buffer *buff,uint8_t *buffer,uint16_t len)
	功能：缓冲区初始化
	参数：*buff缓存区队列句柄 ,*buffer缓存区空间，缓存区长度
	返回值：无
*******************************************************************************/
void buffer_init(Buffer *buff,uint8_t *buffer,uint16_t len)
{
	buff->buf = buffer;
	buff->len = len;
	buff->end = 0;
	buff->head = 0;
}
/******************************************************************************
	函数名：void put_data(Buffer *buff, uint8_t dat)
	功能：向缓存区存入一字节数据
	参数：buff缓存区句柄，要存入的数据
	返回值：无
*******************************************************************************/
void put_data(Buffer *buff, uint8_t dat)
{
	if(!is_full(buff))
	{
		buff->buf[(buff->end)++] = dat;
		if(buff->end == buff->len)
			buff->end = 0;
	}
}
/******************************************************************************
	函数名：uint8_t get_data(Buffer *buff)
	功能：读取一字节数据
	参数：buff缓存区句柄
	返回值：读取的数据
*******************************************************************************/
uint8_t get_data(Buffer *buff)
{
	uint8_t val=0;
	if(get_size(buff))
	{
		val = buff->buf[(buff->head)++];
		if(buff->head == buff->len)
			buff->head = 0;
	}
	return val;
}
/******************************************************************************
	函数名：bit is_full(Buffer *buff)
	功能：判断缓存区是否存满
	参数：buff缓存区句柄
	返回值：返回1为存满，0为未存满
*******************************************************************************/
uint8_t is_full(Buffer *buff)
{
	return (get_size(buff) == (buff->len - 1));
}
/******************************************************************************
	函数名：uint16_t get_size(Buffer *buff)
	功能：得到缓存区现有数据长度
	参数：buff缓存区句柄
	返回值：已有数据长度  	
*******************************************************************************/
uint16_t get_size(Buffer *buff)
{
	if(buff->end >= buff->head)
		return buff->end - buff->head;
	else
		return (buff->len + buff->end - buff->head);
}
/******************************************************************************
	函数名：bit is_empty(Buffer *buff)
	功能：判断缓存区是否为空
	参数：buff缓存区句柄
	返回值：1为空，0为非空
*******************************************************************************/
uint8_t is_empty(Buffer *buff)
{
	return (buff->head == buff->end);
}
/******************************************************************************
	函数名：void clear_buf(Buffer *buff)
	功能：清除缓存区内数据
	参数：buff缓存区句柄
	返回值：无
*******************************************************************************/
void clear_buf(Buffer *buff)
{
	buff->head = buff->end;
}

